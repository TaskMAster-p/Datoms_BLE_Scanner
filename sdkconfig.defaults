## sdkconfig.defaults
```kconfig
# Enable Bluetooth Hardware and Controller
CONFIG_BT_ENABLED=y
CONFIG_BT_CONTROLLER_ENABLED=y
CONFIG_BTDM_CTRL_MODE_BLE_ONLY=y

# Enable NimBLE Stack (instead of Bluedroid)
CONFIG_BT_NIMBLE_ENABLED=y

# Flash configuration (Adjust size if your board has a 4MB flash instead of 2MB)
CONFIG_ESPTOOLPY_FLASHMODE_DIO=y
CONFIG_ESPTOOLPY_FLASHFREQ_40M=y
CONFIG_ESPTOOLPY_FLASHSIZE_2MB=y
```
